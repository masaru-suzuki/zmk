## app/boards/shields/ergo/Kconfig.defconfig
```kconfig
# Copyright (c) 2020 The ZMK Contributors
# SPDX-License-Identifier: MITif SHIELD_ERGO_LEFT

if SHIELD_ERGO_LEFT

config ZMK_KEYBOARD_NAME
	default "ergo_left"

config ZMK_SPLIT_BLE_ROLE_CENTRAL
	default y

endif

if SHIELD_ERGO_RIGHT

config ZMK_KEYBOARD_NAME
	default "ergo_right"

endif

if SHIELD_ERGO_LEFT || SHIELD_ERGO_RIGHT

config ZMK_SPLIT
	default y


endif
```

## app/boards/shields/ergo/Kconfig.shield
```kconfig
# Copyright (c) 2020 Pete Johanson
# SPDX-License-Identifier: MIT

config SHIELD_ERGO_LEFT
	def_bool $(shields_list_contains,ergo_left)

config SHIELD_ERGO_RIGHT
	def_bool $(shields_list_contains,ergo_right)
```
